## conf/layer.conf
```bitbake
# We have a conf and classes directory, add to BBPATH
BBPATH .= ":${LAYERDIR}"

# We have recipes-* directories, add to BBFILES
BBFILES += "${LAYERDIR}/recipes-*/*/*.bb \
            ${LAYERDIR}/recipes-*/*/*.bbappend"

BBFILE_COLLECTIONS += "meta-sway"
BBFILE_PATTERN_meta-sway = "^${LAYERDIR}/"
BBFILE_PRIORITY_meta-sway = "6"

LAYERDEPENDS_meta-sway = "core"
LAYERSERIES_COMPAT_meta-sway = "dunfell"
```
